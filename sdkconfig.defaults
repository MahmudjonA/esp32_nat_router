## sdkconfig.defaults
```kconfig
CONFIG_ESPTOOLPY_FLASHSIZE_4MB=y
CONFIG_PARTITION_TABLE_CUSTOM=y
CONFIG_PARTITION_TABLE_FILENAME="larger.csv"
CONFIG_LWIP_IP_FORWARD=y
CONFIG_LWIP_IP_NAPT=y
CONFIG_LWIP_NAT64=n
```
